## conf/distro/chronos.conf
```bitbake
# distribution config                                                                                                                                                                                                                                                            
DISTRO = "chronos"
DISTRO_NAME = "chronos"
DISTRO_VERSION = "${DATE}"

TARGET_VENDOR = "-chronos"

IMAGE_FSTYPES ?= "tar.bz2 squashfs"
PACKAGE_CLASSES = "package_ipk"

GLIBC_GENERATE_LOCALES = "en_US.UTF-8"
IMAGE_LINGUAS = "en-us"

DISTRO_FEATURES_append = " \
  sysvinit \
  "
```

## conf/layer.conf
```bitbake
# layer config

BBPATH .= ":${LAYERDIR}"

BBFILES += " \
  ${LAYERDIR}/recipes-*/*/*.bb \
  ${LAYERDIR}/recipes-*/*/*.bbappend \
  "

BBFILE_COLLECTIONS += "chronos"
BBFILE_PATTERN_chronos = "${LAYERDIR}/"
BBFILE_PRIORITY_chronos = "99"

# layer
LAYERVERSION_chronos = "1"

LICENSE_PATH += "${LAYERDIR}/licenses"

LAYERDEPENDS_chronos += " \
  core \
  "
```
